## boards/st/xwing_dumb/Kconfig.defconfig
```kconfig
# STM32H563ZI Nucleo board configuration

# Copyright (c) 2023 Thomas Stranger
# SPDX-License-Identifier: Apache-2.0

if BOARD_XWING_DUMB

config BOARD
	default "xwing_dumb"

endif # BOARD_XWING_DUMB
```

## boards/st/xwing_dumb/Kconfig.xwing_dumber
```kconfig
# Copyright (c) 2024
# SPDX-License-Identifier: Apache-2.0

config BOARD_XWING_DUMB
	select SOC_STM32H563XX
```

## boards/st/xwing_dumb/board.yml
```yaml
board:
  name: xwing_dumb
  full_name: XWing Dumb FCC
  vendor: st
  socs:
    - name: stm32h563xx
```

## hello_world/build/primary/Kconfig/Kconfig.modules
```kconfig
menu "cmsis (C:/Users/yukis/ZephyrWorkbench/ASDP4_Workspace/deps/modules/hal/cmsis)"
osource "$(ZEPHYR_CMSIS_KCONFIG)"
config ZEPHYR_CMSIS_MODULE
	bool
	default y
endmenu
menu "cmsis-dsp (C:/Users/yukis/ZephyrWorkbench/ASDP4_Workspace/deps/modules/lib/cmsis-dsp)"
osource "$(ZEPHYR_CMSIS_DSP_KCONFIG)"
config ZEPHYR_CMSIS_DSP_MODULE
	bool
	default y
endmenu
menu "cmsis_6 (C:/Users/yukis/ZephyrWorkbench/ASDP4_Workspace/deps/modules/hal/cmsis_6)"
osource "$(ZEPHYR_CMSIS_6_KCONFIG)"
config ZEPHYR_CMSIS_6_MODULE
	bool
	default y
endmenu
config ZEPHYR_HAL_STM32_MODULE
	bool
	default y

config ZEPHYR_HAL_STM32_MODULE_BLOBS
	bool
config ZEPHYR_MCUBOOT_MODULE
	bool
	default y
menu "percepio (C:/Users/yukis/ZephyrWorkbench/ASDP4_Workspace/deps/modules/debug/percepio)"
osource "C:/Users/yukis/ZephyrWorkbench/ASDP4_Workspace/deps/modules/debug/percepio/zephyr/Kconfig"
config ZEPHYR_PERCEPIO_MODULE
	bool
	default y
endmenu
menu "picolibc (C:/Users/yukis/ZephyrWorkbench/ASDP4_Workspace/deps/modules/lib/picolibc)"
osource "C:/Users/yukis/ZephyrWorkbench/ASDP4_Workspace/deps/modules/lib/picolibc/zephyr/Kconfig"
config ZEPHYR_PICOLIBC_MODULE
	bool
	default y
endmenu
menu "segger (C:/Users/yukis/ZephyrWorkbench/ASDP4_Workspace/deps/modules/debug/segger)"
osource "$(ZEPHYR_SEGGER_KCONFIG)"
config ZEPHYR_SEGGER_MODULE
	bool
	default y
endmenu
```

## hello_world/build/primary/Kconfig/Kconfig.shield.defconfig
```kconfig
osource "C:/Users/yukis/ZephyrWorkbench/ASDP4_Workspace/hello_world/../boards/shields/*/Kconfig.defconfig"
```

## hello_world/build/primary/Kconfig/arch/Kconfig.tmp
```kconfig
# Load Zephyr Arch Kconfig descriptions.
osource "C:/Users/yukis/ZephyrWorkbench/ASDP4_Workspace/deps/zephyr/arch/rx/Kconfig"
osource "C:/Users/yukis/ZephyrWorkbench/ASDP4_Workspace/deps/zephyr/arch/x86/Kconfig"
osource "C:/Users/yukis/ZephyrWorkbench/ASDP4_Workspace/deps/zephyr/arch/xtensa/Kconfig"
osource "C:/Users/yukis/ZephyrWorkbench/ASDP4_Workspace/deps/zephyr/arch/sparc/Kconfig"
osource "C:/Users/yukis/ZephyrWorkbench/ASDP4_Workspace/deps/zephyr/arch/riscv/Kconfig"
osource "C:/Users/yukis/ZephyrWorkbench/ASDP4_Workspace/deps/zephyr/arch/posix/Kconfig"
osource "C:/Users/yukis/ZephyrWorkbench/ASDP4_Workspace/deps/zephyr/arch/openrisc/Kconfig"
osource "C:/Users/yukis/ZephyrWorkbench/ASDP4_Workspace/deps/zephyr/arch/mips/Kconfig"
osource "C:/Users/yukis/ZephyrWorkbench/ASDP4_Workspace/deps/zephyr/arch/arm64/Kconfig"
osource "C:/Users/yukis/ZephyrWorkbench/ASDP4_Workspace/deps/zephyr/arch/arm/Kconfig"
osource "C:/Users/yukis/ZephyrWorkbench/ASDP4_Workspace/deps/zephyr/arch/arc/Kconfig"
```

## hello_world/build/primary/Kconfig/boards/Kconfig.defconfig
```kconfig
# Load Zephyr board defconfig descriptions.
osource "C:/Users/yukis/ZephyrWorkbench/ASDP4_Workspace/boards/st/xwing_dumber/Kconfig.defconfig"
```

## hello_world/build/primary/Kconfig/boards/Kconfig.sysbuild.tmp
```kconfig
# Load Sysbuild board Kconfig descriptions.
osource "C:/Users/yukis/ZephyrWorkbench/ASDP4_Workspace/boards/st/xwing_dumber/Kconfig.sysbuild"
```

## hello_world/build/primary/Kconfig/soc/Kconfig
```kconfig
# Load Zephyr SoC Kconfig descriptions.
osource "C:/Users/yukis/ZephyrWorkbench/ASDP4_Workspace/deps/zephyr/soc/xlnx/zynqmp/Kconfig"
osource "C:/Users/yukis/ZephyrWorkbench/ASDP4_Workspace/deps/zephyr/soc/xlnx/zynq7000/Kconfig"
osource "C:/Users/yukis/ZephyrWorkbench/ASDP4_Workspace/deps/zephyr/soc/xlnx/versalnet/Kconfig"
osource "C:/Users/yukis/ZephyrWorkbench/ASDP4_Workspace/deps/zephyr/soc/xlnx/versal2/Kconfig"
osource "C:/Users/yukis/ZephyrWorkbench/ASDP4_Workspace/deps/zephyr/soc/xlnx/versal/Kconfig"
osource "C:/Users/yukis/ZephyrWorkbench/ASDP4_Workspace/deps/zephyr/soc/xen/Kconfig"
osource "C:/Users/yukis/ZephyrWorkbench/ASDP4_Workspace/deps/zephyr/soc/wch/ch32v/Kconfig"
osource "C:/Users/yukis/ZephyrWorkbench/ASDP4_Workspace/deps/zephyr/soc/ti/simplelink/Kconfig"
osource "C:/Users/yukis/ZephyrWorkbench/ASDP4_Workspace/deps/zephyr/soc/ti/mspm0/Kconfig"
osource "C:/Users/yukis/ZephyrWorkbench/ASDP4_Workspace/deps/zephyr/soc/ti/lm3s6965/Kconfig"
osource "C:/Users/yukis/ZephyrWorkbench/ASDP4_Workspace/deps/zephyr/soc/ti/k3/Kconfig"
osource "C:/Users/yukis/ZephyrWorkbench/ASDP4_Workspace/deps/zephyr/soc/telink/tlsr/Kconfig"
osource "C:/Users/yukis/ZephyrWorkbench/ASDP4_Workspace/deps/zephyr/soc/synaptics/sr100/Kconfig"
osource "C:/Users/yukis/ZephyrWorkbench/ASDP4_Workspace/deps/zephyr/soc/starfive/jh71xx/Kconfig"
osource "C:/Users/yukis/ZephyrWorkbench/ASDP4_Workspace/deps/zephyr/soc/st/stm32/Kconfig"
osource "C:/Users/yukis/ZephyrWorkbench/ASDP4_Workspace/deps/zephyr/soc/snps/qemu_arc/Kconfig"
osource "C:/Users/yukis/ZephyrWorkbench/ASDP4_Workspace/deps/zephyr/soc/snps/nsim/arc_v/Kconfig"
osource "C:/Users/yukis/ZephyrWorkbench/ASDP4_Workspace/deps/zephyr/soc/snps/nsim/arc_classic/Kconfig"
osource "C:/Users/yukis/ZephyrWorkbench/ASDP4_Workspace/deps/zephyr/soc/snps/hsdk4xd/Kconfig"
osource "C:/Users/yukis/ZephyrWorkbench/ASDP4_Workspace/deps/zephyr/soc/snps/hsdk/Kconfig"
osource "C:/Users/yukis/ZephyrWorkbench/ASDP4_Workspace/deps/zephyr/soc/snps/emsk/Kconfig"
osource "C:/Users/yukis/ZephyrWorkbench/ASDP4_Workspace/deps/zephyr/soc/snps/emsdp/Kconfig"
osource "C:/Users/yukis/ZephyrWorkbench/ASDP4_Workspace/deps/zephyr/soc/snps/arc_iot/Kconfig"
osource "C:/Users/yukis/ZephyrWorkbench/ASDP4_Workspace/deps/zephyr/soc/silabs/Kconfig"
osource "C:/Users/yukis/ZephyrWorkbench/ASDP4_Workspace/deps/zephyr/soc/sifli/sf32/Kconfig"
osource "C:/Users/yukis/ZephyrWorkbench/ASDP4_Workspace/deps/zephyr/soc/sifive/sifive_freedom/Kconfig"
osource "C:/Users/yukis/ZephyrWorkbench/ASDP4_Workspace/deps/zephyr/soc/sensry/Kconfig"
osource "C:/Users/yukis/ZephyrWorkbench/ASDP4_Workspace/deps/zephyr/soc/rockchip/Kconfig"
osource "C:/Users/yukis/ZephyrWorkbench/ASDP4_Workspace/deps/zephyr/soc/renode/riscv_virtual/Kconfig"
osource "C:/Users/yukis/ZephyrWorkbench/ASDP4_Workspace/deps/zephyr/soc/renode/cortex_r8_virtual/Kconfig"
osource "C:/Users/yukis/ZephyrWorkbench/ASDP4_Workspace/deps/zephyr/soc/renesas/smartbond/Kconfig"
osource "C:/Users/yukis/ZephyrWorkbench/ASDP4_Workspace/deps/zephyr/soc/renesas/rz/Kconfig"
osource "C:/Users/yukis/ZephyrWorkbench/ASDP4_Workspace/deps/zephyr/soc/renesas/rx/Kconfig"
osource "C:/Users/yukis/ZephyrWorkbench/ASDP4_Workspace/deps/zephyr/soc/renesas/rcar/Kconfig"
osource "C:/Users/yukis/ZephyrWorkbench/ASDP4_Workspace/deps/zephyr/soc/renesas/ra/Kconfig"
osource "C:/Users/yukis/ZephyrWorkbench/ASDP4_Workspace/deps/zephyr/soc/realtek/fingerprint/Kconfig"
osource "C:/Users/yukis/ZephyrWorkbench/ASDP4_Workspace/deps/zephyr/soc/realtek/ec/Kconfig"
osource "C:/Users/yukis/ZephyrWorkbench/ASDP4_Workspace/deps/zephyr/soc/realtek/bee/Kconfig"
osource "C:/Users/yukis/ZephyrWorkbench/ASDP4_Workspace/deps/zephyr/soc/realtek/ameba/Kconfig"
osource "C:/Users/yukis/ZephyrWorkbench/ASDP4_Workspace/deps/zephyr/soc/raspberrypi/rpi_pico/Kconfig"
osource "C:/Users/yukis/ZephyrWorkbench/ASDP4_Workspace/deps/zephyr/soc/quicklogic/eos_s3/Kconfig"
osource "C:/Users/yukis/ZephyrWorkbench/ASDP4_Workspace/deps/zephyr/soc/qemu/virt_riscv/Kconfig"
osource "C:/Users/yukis/ZephyrWorkbench/ASDP4_Workspace/deps/zephyr/soc/qemu/or1k/Kconfig"
osource "C:/Users/yukis/ZephyrWorkbench/ASDP4_Workspace/deps/zephyr/soc/qemu/malta/Kconfig"
osource "C:/Users/yukis/ZephyrWorkbench/ASDP4_Workspace/deps/zephyr/soc/openisa/rv32m1/Kconfig"
osource "C:/Users/yukis/ZephyrWorkbench/ASDP4_Workspace/deps/zephyr/soc/openhwgroup/cva6/Kconfig"
osource "C:/Users/yukis/ZephyrWorkbench/ASDP4_Workspace/deps/zephyr/soc/oct/osd32mp15x/Kconfig"
osource "C:/Users/yukis/ZephyrWorkbench/ASDP4_Workspace/deps/zephyr/soc/nxp/s32/Kconfig"
osource "C:/Users/yukis/ZephyrWorkbench/ASDP4_Workspace/deps/zephyr/soc/nxp/rw/Kconfig"
osource "C:/Users/yukis/ZephyrWorkbench/ASDP4_Workspace/deps/zephyr/soc/nxp/mcx/Kconfig"
osource "C:/Users/yukis/ZephyrWorkbench/ASDP4_Workspace/deps/zephyr/soc/nxp/lpc/Kconfig"
osource "C:/Users/yukis/ZephyrWorkbench/ASDP4_Workspace/deps/zephyr/soc/nxp/layerscape/Kconfig"
osource "C:/Users/yukis/ZephyrWorkbench/ASDP4_Workspace/deps/zephyr/soc/nxp/kinetis/Kconfig"
osource "C:/Users/yukis/ZephyrWorkbench/ASDP4_Workspace/deps/zephyr/soc/nxp/imxrt/Kconfig"
osource "C:/Users/yukis/ZephyrWorkbench/ASDP4_Workspace/deps/zephyr/soc/nxp/imx/Kconfig"
osource "C:/Users/yukis/ZephyrWorkbench/ASDP4_Workspace/deps/zephyr/soc/nuvoton/numicro/Kconfig"
osource "C:/Users/yukis/ZephyrWorkbench/ASDP4_Workspace/deps/zephyr/soc/nuvoton/numaker/Kconfig"
osource "C:/Users/yukis/ZephyrWorkbench/ASDP4_Workspace/deps/zephyr/soc/nuvoton/npcx/Kconfig"
osource "C:/Users/yukis/ZephyrWorkbench/ASDP4_Workspace/deps/zephyr/soc/nuvoton/npcm/Kconfig"
osource "C:/Users/yukis/ZephyrWorkbench/ASDP4_Workspace/deps/zephyr/soc/nordic/Kconfig"
osource "C:/Users/yukis/ZephyrWorkbench/ASDP4_Workspace/deps/zephyr/soc/neorv32/Kconfig"
osource "C:/Users/yukis/ZephyrWorkbench/ASDP4_Workspace/deps/zephyr/soc/native/inf_clock/Kconfig"
osource "C:/Users/yukis/ZephyrWorkbench/ASDP4_Workspace/deps/zephyr/soc/microchip/sam/sama7/Kconfig"
osource "C:/Users/yukis/ZephyrWorkbench/ASDP4_Workspace/deps/zephyr/soc/microchip/sam/sam_d5x_e5x/Kconfig"
osource "C:/Users/yukis/ZephyrWorkbench/ASDP4_Workspace/deps/zephyr/soc/microchip/pic64/Kconfig"
osource "C:/Users/yukis/ZephyrWorkbench/ASDP4_Workspace/deps/zephyr/soc/microchip/pic32c/pic32cz_ca/Kconfig"
osource "C:/Users/yukis/ZephyrWorkbench/ASDP4_Workspace/deps/zephyr/soc/microchip/pic32c/pic32cx_sg/Kconfig"
osource "C:/Users/yukis/ZephyrWorkbench/ASDP4_Workspace/deps/zephyr/soc/microchip/pic32c/pic32cm_pl/Kconfig"
osource "C:/Users/yukis/ZephyrWorkbench/ASDP4_Workspace/deps/zephyr/soc/microchip/pic32c/pic32cm_jh/Kconfig"
osource "C:/Users/yukis/ZephyrWorkbench/ASDP4_Workspace/deps/zephyr/soc/microchip/miv/Kconfig"
osource "C:/Users/yukis/ZephyrWorkbench/ASDP4_Workspace/deps/zephyr/soc/microchip/mec/Kconfig"
osource "C:/Users/yukis/ZephyrWorkbench/ASDP4_Workspace/deps/zephyr/soc/mediatek/mt8xxx/Kconfig"
osource "C:/Users/yukis/ZephyrWorkbench/ASDP4_Workspace/deps/zephyr/soc/lowrisc/opentitan/Kconfig"
osource "C:/Users/yukis/ZephyrWorkbench/ASDP4_Workspace/deps/zephyr/soc/litex/litex_vexriscv/Kconfig"
osource "C:/Users/yukis/ZephyrWorkbench/ASDP4_Workspace/deps/zephyr/soc/ite/ec/Kconfig"
osource "C:/Users/yukis/ZephyrWorkbench/ASDP4_Workspace/deps/zephyr/soc/intel/wildcat_lake/Kconfig"
osource "C:/Users/yukis/ZephyrWorkbench/ASDP4_Workspace/deps/zephyr/soc/intel/raptor_lake/Kconfig"
osource "C:/Users/yukis/ZephyrWorkbench/ASDP4_Workspace/deps/zephyr/soc/intel/panther_lake/Kconfig"
osource "C:/Users/yukis/ZephyrWorkbench/ASDP4_Workspace/deps/zephyr/soc/intel/lakemont/Kconfig"
osource "C:/Users/yukis/ZephyrWorkbench/ASDP4_Workspace/deps/zephyr/soc/intel/intel_socfpga_std/Kconfig"
osource "C:/Users/yukis/ZephyrWorkbench/ASDP4_Workspace/deps/zephyr/soc/intel/intel_socfpga/Kconfig"
osource "C:/Users/yukis/ZephyrWorkbench/ASDP4_Workspace/deps/zephyr/soc/intel/intel_niosv/Kconfig"
osource "C:/Users/yukis/ZephyrWorkbench/ASDP4_Workspace/deps/zephyr/soc/intel/intel_ish/Kconfig"
osource "C:/Users/yukis/ZephyrWorkbench/ASDP4_Workspace/deps/zephyr/soc/intel/intel_adsp/Kconfig"
osource "C:/Users/yukis/ZephyrWorkbench/ASDP4_Workspace/deps/zephyr/soc/intel/elkhart_lake/Kconfig"
osource "C:/Users/yukis/ZephyrWorkbench/ASDP4_Workspace/deps/zephyr/soc/intel/atom/Kconfig"
osource "C:/Users/yukis/ZephyrWorkbench/ASDP4_Workspace/deps/zephyr/soc/intel/apollo_lake/Kconfig"
osource "C:/Users/yukis/ZephyrWorkbench/ASDP4_Workspace/deps/zephyr/soc/intel/alder_lake/Kconfig"
osource "C:/Users/yukis/ZephyrWorkbench/ASDP4_Workspace/deps/zephyr/soc/infineon/psoc4/Kconfig"
osource "C:/Users/yukis/ZephyrWorkbench/ASDP4_Workspace/deps/zephyr/soc/infineon/edge/Kconfig"
osource "C:/Users/yukis/ZephyrWorkbench/ASDP4_Workspace/deps/zephyr/soc/infineon/cat3/Kconfig"
osource "C:/Users/yukis/ZephyrWorkbench/ASDP4_Workspace/deps/zephyr/soc/infineon/cat1c/Kconfig"
osource "C:/Users/yukis/ZephyrWorkbench/ASDP4_Workspace/deps/zephyr/soc/infineon/cat1b/Kconfig"
osource "C:/Users/yukis/ZephyrWorkbench/ASDP4_Workspace/deps/zephyr/soc/infineon/cat1a/Kconfig"
osource "C:/Users/yukis/ZephyrWorkbench/ASDP4_Workspace/deps/zephyr/soc/gd/gd32/Kconfig"
osource "C:/Users/yukis/ZephyrWorkbench/ASDP4_Workspace/deps/zephyr/soc/gaisler/leon3/Kconfig"
osource "C:/Users/yukis/ZephyrWorkbench/ASDP4_Workspace/deps/zephyr/soc/gaisler/gr716a/Kconfig"
osource "C:/Users/yukis/ZephyrWorkbench/ASDP4_Workspace/deps/zephyr/soc/focaltech/Kconfig"
osource "C:/Users/yukis/ZephyrWorkbench/ASDP4_Workspace/deps/zephyr/soc/espressif/Kconfig"
osource "C:/Users/yukis/ZephyrWorkbench/ASDP4_Workspace/deps/zephyr/soc/ene/kb1200/Kconfig"
osource "C:/Users/yukis/ZephyrWorkbench/ASDP4_Workspace/deps/zephyr/soc/ene/kb106x/Kconfig"
osource "C:/Users/yukis/ZephyrWorkbench/ASDP4_Workspace/deps/zephyr/soc/elan/em32f967/Kconfig"
osource "C:/Users/yukis/ZephyrWorkbench/ASDP4_Workspace/deps/zephyr/soc/egis/Kconfig"
osource "C:/Users/yukis/ZephyrWorkbench/ASDP4_Workspace/deps/zephyr/soc/efinix/sapphire/Kconfig"
osource "C:/Users/yukis/ZephyrWorkbench/ASDP4_Workspace/deps/zephyr/soc/cdns/xtensa_sample_controller/Kconfig"
osource "C:/Users/yukis/ZephyrWorkbench/ASDP4_Workspace/deps/zephyr/soc/cdns/swerv/Kconfig"
osource "C:/Users/yukis/ZephyrWorkbench/ASDP4_Workspace/deps/zephyr/soc/cdns/sample_controller32/Kconfig"
osource "C:/Users/yukis/ZephyrWorkbench/ASDP4_Workspace/deps/zephyr/soc/cdns/dc233c/Kconfig"
osource "C:/Users/yukis/ZephyrWorkbench/ASDP4_Workspace/deps/zephyr/soc/brcm/bcmvk/Kconfig"
osource "C:/Users/yukis/ZephyrWorkbench/ASDP4_Workspace/deps/zephyr/soc/brcm/bcm2712/Kconfig"
osource "C:/Users/yukis/ZephyrWorkbench/ASDP4_Workspace/deps/zephyr/soc/brcm/bcm2711/Kconfig"
osource "C:/Users/yukis/ZephyrWorkbench/ASDP4_Workspace/deps/zephyr/soc/blackberry/qnxhv_vm/Kconfig"
osource "C:/Users/yukis/ZephyrWorkbench/ASDP4_Workspace/deps/zephyr/soc/bflb/Kconfig"
osource "C:/Users/yukis/ZephyrWorkbench/ASDP4_Workspace/deps/zephyr/soc/atmel/sam0/Kconfig"
osource "C:/Users/yukis/ZephyrWorkbench/ASDP4_Workspace/deps/zephyr/soc/atmel/sam/Kconfig"
osource "C:/Users/yukis/ZephyrWorkbench/ASDP4_Workspace/deps/zephyr/soc/aspeed/Kconfig"
osource "C:/Users/yukis/ZephyrWorkbench/ASDP4_Workspace/deps/zephyr/soc/arm/Kconfig"
osource "C:/Users/yukis/ZephyrWorkbench/ASDP4_Workspace/deps/zephyr/soc/arm/beetle/Kconfig"
osource "C:/Users/yukis/ZephyrWorkbench/ASDP4_Workspace/deps/zephyr/soc/antmicro/myra/Kconfig"
osource "C:/Users/yukis/ZephyrWorkbench/ASDP4_Workspace/deps/zephyr/soc/andestech/Kconfig"
osource "C:/Users/yukis/ZephyrWorkbench/ASDP4_Workspace/deps/zephyr/soc/amd/acp_6_0/Kconfig"
osource "C:/Users/yukis/ZephyrWorkbench/ASDP4_Workspace/deps/zephyr/soc/ambiq/Kconfig"
osource "C:/Users/yukis/ZephyrWorkbench/ASDP4_Workspace/deps/zephyr/soc/allwinner/sun8i_h3/Kconfig"
osource "C:/Users/yukis/ZephyrWorkbench/ASDP4_Workspace/deps/zephyr/soc/alif/ensemble/Kconfig"
osource "C:/Users/yukis/ZephyrWorkbench/ASDP4_Workspace/deps/zephyr/soc/aesc/Kconfig"
osource "C:/Users/yukis/ZephyrWorkbench/ASDP4_Workspace/deps/zephyr/soc/adi/max32/Kconfig"
```
