## hello_world/build/primary/Kconfig/soc/Kconfig.sysbuild.tmp
```kconfig
# Load Sysbuild SoC Kconfig descriptions.
osource "C:/Users/yukis/ZephyrWorkbench/ASDP4_Workspace/deps/zephyr/soc/xlnx/zynqmp/Kconfig.sysbuild"
osource "C:/Users/yukis/ZephyrWorkbench/ASDP4_Workspace/deps/zephyr/soc/xlnx/zynq7000/Kconfig.sysbuild"
osource "C:/Users/yukis/ZephyrWorkbench/ASDP4_Workspace/deps/zephyr/soc/xlnx/versalnet/Kconfig.sysbuild"
osource "C:/Users/yukis/ZephyrWorkbench/ASDP4_Workspace/deps/zephyr/soc/xlnx/versal2/Kconfig.sysbuild"
osource "C:/Users/yukis/ZephyrWorkbench/ASDP4_Workspace/deps/zephyr/soc/xlnx/versal/Kconfig.sysbuild"
osource "C:/Users/yukis/ZephyrWorkbench/ASDP4_Workspace/deps/zephyr/soc/xen/Kconfig.sysbuild"
osource "C:/Users/yukis/ZephyrWorkbench/ASDP4_Workspace/deps/zephyr/soc/wch/ch32v/Kconfig.sysbuild"
osource "C:/Users/yukis/ZephyrWorkbench/ASDP4_Workspace/deps/zephyr/soc/ti/simplelink/Kconfig.sysbuild"
osource "C:/Users/yukis/ZephyrWorkbench/ASDP4_Workspace/deps/zephyr/soc/ti/mspm0/Kconfig.sysbuild"
osource "C:/Users/yukis/ZephyrWorkbench/ASDP4_Workspace/deps/zephyr/soc/ti/lm3s6965/Kconfig.sysbuild"
osource "C:/Users/yukis/ZephyrWorkbench/ASDP4_Workspace/deps/zephyr/soc/ti/k3/Kconfig.sysbuild"
osource "C:/Users/yukis/ZephyrWorkbench/ASDP4_Workspace/deps/zephyr/soc/telink/tlsr/Kconfig.sysbuild"
osource "C:/Users/yukis/ZephyrWorkbench/ASDP4_Workspace/deps/zephyr/soc/synaptics/sr100/Kconfig.sysbuild"
osource "C:/Users/yukis/ZephyrWorkbench/ASDP4_Workspace/deps/zephyr/soc/starfive/jh71xx/Kconfig.sysbuild"
osource "C:/Users/yukis/ZephyrWorkbench/ASDP4_Workspace/deps/zephyr/soc/st/stm32/Kconfig.sysbuild"
osource "C:/Users/yukis/ZephyrWorkbench/ASDP4_Workspace/deps/zephyr/soc/snps/qemu_arc/Kconfig.sysbuild"
osource "C:/Users/yukis/ZephyrWorkbench/ASDP4_Workspace/deps/zephyr/soc/snps/nsim/arc_v/Kconfig.sysbuild"
osource "C:/Users/yukis/ZephyrWorkbench/ASDP4_Workspace/deps/zephyr/soc/snps/nsim/arc_classic/Kconfig.sysbuild"
osource "C:/Users/yukis/ZephyrWorkbench/ASDP4_Workspace/deps/zephyr/soc/snps/hsdk4xd/Kconfig.sysbuild"
osource "C:/Users/yukis/ZephyrWorkbench/ASDP4_Workspace/deps/zephyr/soc/snps/hsdk/Kconfig.sysbuild"
osource "C:/Users/yukis/ZephyrWorkbench/ASDP4_Workspace/deps/zephyr/soc/snps/emsk/Kconfig.sysbuild"
osource "C:/Users/yukis/ZephyrWorkbench/ASDP4_Workspace/deps/zephyr/soc/snps/emsdp/Kconfig.sysbuild"
osource "C:/Users/yukis/ZephyrWorkbench/ASDP4_Workspace/deps/zephyr/soc/snps/arc_iot/Kconfig.sysbuild"
osource "C:/Users/yukis/ZephyrWorkbench/ASDP4_Workspace/deps/zephyr/soc/silabs/Kconfig.sysbuild"
osource "C:/Users/yukis/ZephyrWorkbench/ASDP4_Workspace/deps/zephyr/soc/sifli/sf32/Kconfig.sysbuild"
osource "C:/Users/yukis/ZephyrWorkbench/ASDP4_Workspace/deps/zephyr/soc/sifive/sifive_freedom/Kconfig.sysbuild"
osource "C:/Users/yukis/ZephyrWorkbench/ASDP4_Workspace/deps/zephyr/soc/sensry/Kconfig.sysbuild"
osource "C:/Users/yukis/ZephyrWorkbench/ASDP4_Workspace/deps/zephyr/soc/rockchip/Kconfig.sysbuild"
osource "C:/Users/yukis/ZephyrWorkbench/ASDP4_Workspace/deps/zephyr/soc/renode/riscv_virtual/Kconfig.sysbuild"
osource "C:/Users/yukis/ZephyrWorkbench/ASDP4_Workspace/deps/zephyr/soc/renode/cortex_r8_virtual/Kconfig.sysbuild"
osource "C:/Users/yukis/ZephyrWorkbench/ASDP4_Workspace/deps/zephyr/soc/renesas/smartbond/Kconfig.sysbuild"
osource "C:/Users/yukis/ZephyrWorkbench/ASDP4_Workspace/deps/zephyr/soc/renesas/rz/Kconfig.sysbuild"
osource "C:/Users/yukis/ZephyrWorkbench/ASDP4_Workspace/deps/zephyr/soc/renesas/rx/Kconfig.sysbuild"
osource "C:/Users/yukis/ZephyrWorkbench/ASDP4_Workspace/deps/zephyr/soc/renesas/rcar/Kconfig.sysbuild"
osource "C:/Users/yukis/ZephyrWorkbench/ASDP4_Workspace/deps/zephyr/soc/renesas/ra/Kconfig.sysbuild"
osource "C:/Users/yukis/ZephyrWorkbench/ASDP4_Workspace/deps/zephyr/soc/realtek/fingerprint/Kconfig.sysbuild"
osource "C:/Users/yukis/ZephyrWorkbench/ASDP4_Workspace/deps/zephyr/soc/realtek/ec/Kconfig.sysbuild"
osource "C:/Users/yukis/ZephyrWorkbench/ASDP4_Workspace/deps/zephyr/soc/realtek/bee/Kconfig.sysbuild"
osource "C:/Users/yukis/ZephyrWorkbench/ASDP4_Workspace/deps/zephyr/soc/realtek/ameba/Kconfig.sysbuild"
osource "C:/Users/yukis/ZephyrWorkbench/ASDP4_Workspace/deps/zephyr/soc/raspberrypi/rpi_pico/Kconfig.sysbuild"
osource "C:/Users/yukis/ZephyrWorkbench/ASDP4_Workspace/deps/zephyr/soc/quicklogic/eos_s3/Kconfig.sysbuild"
osource "C:/Users/yukis/ZephyrWorkbench/ASDP4_Workspace/deps/zephyr/soc/qemu/virt_riscv/Kconfig.sysbuild"
osource "C:/Users/yukis/ZephyrWorkbench/ASDP4_Workspace/deps/zephyr/soc/qemu/or1k/Kconfig.sysbuild"
osource "C:/Users/yukis/ZephyrWorkbench/ASDP4_Workspace/deps/zephyr/soc/qemu/malta/Kconfig.sysbuild"
osource "C:/Users/yukis/ZephyrWorkbench/ASDP4_Workspace/deps/zephyr/soc/openisa/rv32m1/Kconfig.sysbuild"
osource "C:/Users/yukis/ZephyrWorkbench/ASDP4_Workspace/deps/zephyr/soc/openhwgroup/cva6/Kconfig.sysbuild"
osource "C:/Users/yukis/ZephyrWorkbench/ASDP4_Workspace/deps/zephyr/soc/oct/osd32mp15x/Kconfig.sysbuild"
osource "C:/Users/yukis/ZephyrWorkbench/ASDP4_Workspace/deps/zephyr/soc/nxp/s32/Kconfig.sysbuild"
osource "C:/Users/yukis/ZephyrWorkbench/ASDP4_Workspace/deps/zephyr/soc/nxp/rw/Kconfig.sysbuild"
osource "C:/Users/yukis/ZephyrWorkbench/ASDP4_Workspace/deps/zephyr/soc/nxp/mcx/Kconfig.sysbuild"
osource "C:/Users/yukis/ZephyrWorkbench/ASDP4_Workspace/deps/zephyr/soc/nxp/lpc/Kconfig.sysbuild"
osource "C:/Users/yukis/ZephyrWorkbench/ASDP4_Workspace/deps/zephyr/soc/nxp/layerscape/Kconfig.sysbuild"
osource "C:/Users/yukis/ZephyrWorkbench/ASDP4_Workspace/deps/zephyr/soc/nxp/kinetis/Kconfig.sysbuild"
osource "C:/Users/yukis/ZephyrWorkbench/ASDP4_Workspace/deps/zephyr/soc/nxp/imxrt/Kconfig.sysbuild"
osource "C:/Users/yukis/ZephyrWorkbench/ASDP4_Workspace/deps/zephyr/soc/nxp/imx/Kconfig.sysbuild"
osource "C:/Users/yukis/ZephyrWorkbench/ASDP4_Workspace/deps/zephyr/soc/nuvoton/numicro/Kconfig.sysbuild"
osource "C:/Users/yukis/ZephyrWorkbench/ASDP4_Workspace/deps/zephyr/soc/nuvoton/numaker/Kconfig.sysbuild"
osource "C:/Users/yukis/ZephyrWorkbench/ASDP4_Workspace/deps/zephyr/soc/nuvoton/npcx/Kconfig.sysbuild"
osource "C:/Users/yukis/ZephyrWorkbench/ASDP4_Workspace/deps/zephyr/soc/nuvoton/npcm/Kconfig.sysbuild"
osource "C:/Users/yukis/ZephyrWorkbench/ASDP4_Workspace/deps/zephyr/soc/nordic/Kconfig.sysbuild"
osource "C:/Users/yukis/ZephyrWorkbench/ASDP4_Workspace/deps/zephyr/soc/neorv32/Kconfig.sysbuild"
osource "C:/Users/yukis/ZephyrWorkbench/ASDP4_Workspace/deps/zephyr/soc/native/inf_clock/Kconfig.sysbuild"
osource "C:/Users/yukis/ZephyrWorkbench/ASDP4_Workspace/deps/zephyr/soc/microchip/sam/sama7/Kconfig.sysbuild"
osource "C:/Users/yukis/ZephyrWorkbench/ASDP4_Workspace/deps/zephyr/soc/microchip/sam/sam_d5x_e5x/Kconfig.sysbuild"
osource "C:/Users/yukis/ZephyrWorkbench/ASDP4_Workspace/deps/zephyr/soc/microchip/pic64/Kconfig.sysbuild"
osource "C:/Users/yukis/ZephyrWorkbench/ASDP4_Workspace/deps/zephyr/soc/microchip/pic32c/pic32cz_ca/Kconfig.sysbuild"
osource "C:/Users/yukis/ZephyrWorkbench/ASDP4_Workspace/deps/zephyr/soc/microchip/pic32c/pic32cx_sg/Kconfig.sysbuild"
osource "C:/Users/yukis/ZephyrWorkbench/ASDP4_Workspace/deps/zephyr/soc/microchip/pic32c/pic32cm_pl/Kconfig.sysbuild"
osource "C:/Users/yukis/ZephyrWorkbench/ASDP4_Workspace/deps/zephyr/soc/microchip/pic32c/pic32cm_jh/Kconfig.sysbuild"
osource "C:/Users/yukis/ZephyrWorkbench/ASDP4_Workspace/deps/zephyr/soc/microchip/miv/Kconfig.sysbuild"
osource "C:/Users/yukis/ZephyrWorkbench/ASDP4_Workspace/deps/zephyr/soc/microchip/mec/Kconfig.sysbuild"
osource "C:/Users/yukis/ZephyrWorkbench/ASDP4_Workspace/deps/zephyr/soc/mediatek/mt8xxx/Kconfig.sysbuild"
osource "C:/Users/yukis/ZephyrWorkbench/ASDP4_Workspace/deps/zephyr/soc/lowrisc/opentitan/Kconfig.sysbuild"
osource "C:/Users/yukis/ZephyrWorkbench/ASDP4_Workspace/deps/zephyr/soc/litex/litex_vexriscv/Kconfig.sysbuild"
osource "C:/Users/yukis/ZephyrWorkbench/ASDP4_Workspace/deps/zephyr/soc/ite/ec/Kconfig.sysbuild"
osource "C:/Users/yukis/ZephyrWorkbench/ASDP4_Workspace/deps/zephyr/soc/intel/wildcat_lake/Kconfig.sysbuild"
osource "C:/Users/yukis/ZephyrWorkbench/ASDP4_Workspace/deps/zephyr/soc/intel/raptor_lake/Kconfig.sysbuild"
osource "C:/Users/yukis/ZephyrWorkbench/ASDP4_Workspace/deps/zephyr/soc/intel/panther_lake/Kconfig.sysbuild"
osource "C:/Users/yukis/ZephyrWorkbench/ASDP4_Workspace/deps/zephyr/soc/intel/lakemont/Kconfig.sysbuild"
osource "C:/Users/yukis/ZephyrWorkbench/ASDP4_Workspace/deps/zephyr/soc/intel/intel_socfpga_std/Kconfig.sysbuild"
osource "C:/Users/yukis/ZephyrWorkbench/ASDP4_Workspace/deps/zephyr/soc/intel/intel_socfpga/Kconfig.sysbuild"
osource "C:/Users/yukis/ZephyrWorkbench/ASDP4_Workspace/deps/zephyr/soc/intel/intel_niosv/Kconfig.sysbuild"
osource "C:/Users/yukis/ZephyrWorkbench/ASDP4_Workspace/deps/zephyr/soc/intel/intel_ish/Kconfig.sysbuild"
osource "C:/Users/yukis/ZephyrWorkbench/ASDP4_Workspace/deps/zephyr/soc/intel/intel_adsp/Kconfig.sysbuild"
osource "C:/Users/yukis/ZephyrWorkbench/ASDP4_Workspace/deps/zephyr/soc/intel/elkhart_lake/Kconfig.sysbuild"
osource "C:/Users/yukis/ZephyrWorkbench/ASDP4_Workspace/deps/zephyr/soc/intel/atom/Kconfig.sysbuild"
osource "C:/Users/yukis/ZephyrWorkbench/ASDP4_Workspace/deps/zephyr/soc/intel/apollo_lake/Kconfig.sysbuild"
osource "C:/Users/yukis/ZephyrWorkbench/ASDP4_Workspace/deps/zephyr/soc/intel/alder_lake/Kconfig.sysbuild"
osource "C:/Users/yukis/ZephyrWorkbench/ASDP4_Workspace/deps/zephyr/soc/infineon/psoc4/Kconfig.sysbuild"
osource "C:/Users/yukis/ZephyrWorkbench/ASDP4_Workspace/deps/zephyr/soc/infineon/edge/Kconfig.sysbuild"
osource "C:/Users/yukis/ZephyrWorkbench/ASDP4_Workspace/deps/zephyr/soc/infineon/cat3/Kconfig.sysbuild"
osource "C:/Users/yukis/ZephyrWorkbench/ASDP4_Workspace/deps/zephyr/soc/infineon/cat1c/Kconfig.sysbuild"
osource "C:/Users/yukis/ZephyrWorkbench/ASDP4_Workspace/deps/zephyr/soc/infineon/cat1b/Kconfig.sysbuild"
osource "C:/Users/yukis/ZephyrWorkbench/ASDP4_Workspace/deps/zephyr/soc/infineon/cat1a/Kconfig.sysbuild"
osource "C:/Users/yukis/ZephyrWorkbench/ASDP4_Workspace/deps/zephyr/soc/gd/gd32/Kconfig.sysbuild"
osource "C:/Users/yukis/ZephyrWorkbench/ASDP4_Workspace/deps/zephyr/soc/gaisler/leon3/Kconfig.sysbuild"
osource "C:/Users/yukis/ZephyrWorkbench/ASDP4_Workspace/deps/zephyr/soc/gaisler/gr716a/Kconfig.sysbuild"
osource "C:/Users/yukis/ZephyrWorkbench/ASDP4_Workspace/deps/zephyr/soc/focaltech/Kconfig.sysbuild"
osource "C:/Users/yukis/ZephyrWorkbench/ASDP4_Workspace/deps/zephyr/soc/espressif/Kconfig.sysbuild"
osource "C:/Users/yukis/ZephyrWorkbench/ASDP4_Workspace/deps/zephyr/soc/ene/kb1200/Kconfig.sysbuild"
osource "C:/Users/yukis/ZephyrWorkbench/ASDP4_Workspace/deps/zephyr/soc/ene/kb106x/Kconfig.sysbuild"
osource "C:/Users/yukis/ZephyrWorkbench/ASDP4_Workspace/deps/zephyr/soc/elan/em32f967/Kconfig.sysbuild"
osource "C:/Users/yukis/ZephyrWorkbench/ASDP4_Workspace/deps/zephyr/soc/egis/Kconfig.sysbuild"
osource "C:/Users/yukis/ZephyrWorkbench/ASDP4_Workspace/deps/zephyr/soc/efinix/sapphire/Kconfig.sysbuild"
osource "C:/Users/yukis/ZephyrWorkbench/ASDP4_Workspace/deps/zephyr/soc/cdns/xtensa_sample_controller/Kconfig.sysbuild"
osource "C:/Users/yukis/ZephyrWorkbench/ASDP4_Workspace/deps/zephyr/soc/cdns/swerv/Kconfig.sysbuild"
osource "C:/Users/yukis/ZephyrWorkbench/ASDP4_Workspace/deps/zephyr/soc/cdns/sample_controller32/Kconfig.sysbuild"
osource "C:/Users/yukis/ZephyrWorkbench/ASDP4_Workspace/deps/zephyr/soc/cdns/dc233c/Kconfig.sysbuild"
osource "C:/Users/yukis/ZephyrWorkbench/ASDP4_Workspace/deps/zephyr/soc/brcm/bcmvk/Kconfig.sysbuild"
osource "C:/Users/yukis/ZephyrWorkbench/ASDP4_Workspace/deps/zephyr/soc/brcm/bcm2712/Kconfig.sysbuild"
osource "C:/Users/yukis/ZephyrWorkbench/ASDP4_Workspace/deps/zephyr/soc/brcm/bcm2711/Kconfig.sysbuild"
osource "C:/Users/yukis/ZephyrWorkbench/ASDP4_Workspace/deps/zephyr/soc/blackberry/qnxhv_vm/Kconfig.sysbuild"
osource "C:/Users/yukis/ZephyrWorkbench/ASDP4_Workspace/deps/zephyr/soc/bflb/Kconfig.sysbuild"
osource "C:/Users/yukis/ZephyrWorkbench/ASDP4_Workspace/deps/zephyr/soc/atmel/sam0/Kconfig.sysbuild"
osource "C:/Users/yukis/ZephyrWorkbench/ASDP4_Workspace/deps/zephyr/soc/atmel/sam/Kconfig.sysbuild"
osource "C:/Users/yukis/ZephyrWorkbench/ASDP4_Workspace/deps/zephyr/soc/aspeed/Kconfig.sysbuild"
osource "C:/Users/yukis/ZephyrWorkbench/ASDP4_Workspace/deps/zephyr/soc/arm/Kconfig.sysbuild"
osource "C:/Users/yukis/ZephyrWorkbench/ASDP4_Workspace/deps/zephyr/soc/arm/beetle/Kconfig.sysbuild"
osource "C:/Users/yukis/ZephyrWorkbench/ASDP4_Workspace/deps/zephyr/soc/antmicro/myra/Kconfig.sysbuild"
osource "C:/Users/yukis/ZephyrWorkbench/ASDP4_Workspace/deps/zephyr/soc/andestech/Kconfig.sysbuild"
osource "C:/Users/yukis/ZephyrWorkbench/ASDP4_Workspace/deps/zephyr/soc/amd/acp_6_0/Kconfig.sysbuild"
osource "C:/Users/yukis/ZephyrWorkbench/ASDP4_Workspace/deps/zephyr/soc/ambiq/Kconfig.sysbuild"
osource "C:/Users/yukis/ZephyrWorkbench/ASDP4_Workspace/deps/zephyr/soc/allwinner/sun8i_h3/Kconfig.sysbuild"
osource "C:/Users/yukis/ZephyrWorkbench/ASDP4_Workspace/deps/zephyr/soc/alif/ensemble/Kconfig.sysbuild"
osource "C:/Users/yukis/ZephyrWorkbench/ASDP4_Workspace/deps/zephyr/soc/aesc/Kconfig.sysbuild"
osource "C:/Users/yukis/ZephyrWorkbench/ASDP4_Workspace/deps/zephyr/soc/adi/max32/Kconfig.sysbuild"
```
