/*
 * Copyright (c) 2021 Linaro Limited
 * Copyright (c) 2023 Thomas Stranger
 *
 * SPDX-License-Identifier: Apache-2.0
 */

/dts-v1/;
#include "xwing_dumber-common.dtsi"

/ {
	model = "STMicroelectronics STM32H563ZI-NUCLEO board";
	compatible = "st,stm32h563zi-nucleo";

	#address-cells = <1>;
	#size-cells = <1>;

	chosen {
		zephyr,console = &usart3;
		zephyr,shell-uart = &usart3;
		zephyr,sram = &sram1;
		zephyr,flash = &flash0;
		zephyr,canbus = &fdcan2;
	};
};

&rng {
	status = "okay";
};
